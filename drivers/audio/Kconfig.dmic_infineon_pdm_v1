## drivers/audio/Kconfig.dmic_infineon_pdm_v1
```kconfig
# Copyright (c) 2026 Infineon Technologies AG
# SPDX-License-Identifier: Apache-2.0

config AUDIO_DMIC_INFINEON_PDM_V1
	bool "Infineon PSOC 6 MXAUDIOSS v1 stereo DMIC"
	default y
	depends on SOC_DIE_PSOC6_02
	depends on DT_HAS_INFINEON_PDM_V1_ENABLED
	select USE_INFINEON_PDM_PCM
	select PINCTRL
	help
	  PSOC 6 MXAUDIOSS v1 PDM driver using IRQ-driven interleaved signed 16-bit
	  stereo PCM slabs. Requires HF1 = 8 MHz. Supports 15625 frames/s only.

config DMIC_INFINEON_PDM_V1_QUEUE_SIZE
	int "PDMv1 completed PCM block queue length"
	depends on AUDIO_DMIC_INFINEON_PDM_V1
	default 8
	range 2 16
```

## drivers/hwinfo/Kconfig.infineon
```kconfig
# SPDX-FileCopyrightText: Copyright (c) 2026 Infineon Technologies AG,
# SPDX-FileCopyrightText: or an affiliate of Infineon Technologies AG. All rights reserved.
#
# SPDX-License-Identifier: Apache-2.0

config HWINFO_INFINEON
	bool "Infineon unique device ID"
	default y
	depends on SOC_FAMILY_INFINEON_EDGE || \
		(SOC_FAMILY_INFINEON_CAT1B && !SOC_SERIES_CYW20829) || \
		SOC_CY8C624ABZI_S2D44
	select HWINFO_HAS_DRIVER
	help
	  Enable Infineon hwinfo driver.
```

## dts/bindings/audio/infineon,pdm-v1.yaml
```yaml
# Copyright (c) 2026 Infineon Technologies AG
# SPDX-License-Identifier: Apache-2.0

description: |
  PSOC 6 MXAUDIOSS v1 PDM to stereo PCM converter. This is not the
  MXPDM v2 peripheral described by infineon,pdm.

compatible: "infineon,pdm-v1"

include: ["base.yaml", "pinctrl-device.yaml"]

properties:
  reg:
    required: true
  interrupts:
    required: true
  clocks:
    description: AUDIOSS HF1 clock source; the driver requires it to run at 8 MHz.
  pinctrl-0:
    required: true
  pinctrl-names:
    required: true
```
